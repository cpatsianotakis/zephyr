## drivers/sensor/scd4x/Kconfig
```kconfig
# SCD4X temperature and humidity sensor configuration options

# Copyright (c) 2016 Intel Corporation
# SPDX-License-Identifier: Apache-2.0

menuconfig SCD4X
	bool "SCD4X CO2 Temperature and Humidity Sensor"
	depends on I2C
	help
	  Enable driver for SCD4X CO2 temperature and humidity sensors.
```

## dts/bindings/sensor/sensirion,scd4x.yaml
```yaml
#
# Copyright (c) 2019 Centaur Analytics, Inc
#
# SPDX-License-Identifier: Apache-2.0
#
---
description: >
    This is a representation of the SCD4x

compatible: "sensirion,scd4x"

include: i2c-device.yaml

...
```

## dts/bindings/serial/caslab,network_uart.yaml
```yaml
---
description: >
    This is a representation of the Network UART

include: uart-device.yaml

compatible: "caslab,network_uart"
```
